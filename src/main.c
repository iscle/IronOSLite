/*
 * T12 Soldering Iron Firmware
 * Pinout:
 * P1.0 - ADC0, VCC
 * P1.1 - ADC1, Tip temperature
 * P1.5 - PWM3N, Tip MOSFET
 * P1.6 - ADC6, 5v
 * P1.7 - ADC7, 5v
 * P2.4 - I2C SDA
 * P2.5 - I2C SCL
 * P3.0 - Left button
 * P3.1 - Center button
 * P3.2 - Right button
 * P3.3 - Shake sensor
 */

#include <stdio.h>
#include <stdint.h>
#include <string.h>
#include "stc8h3k64s2.h"
#include "i2c.h"
#include "wdt.h"
#include "adc.h"
#include "timer.h"
#include "eeprom.h"
#include "gpio.h"
#include "oled.h"
#include "config.h"

static const unsigned char font[] = {
    0x00, 0x00, 0x00, 0x00, 0x00,
    0x3E, 0x5B, 0x4F, 0x5B, 0x3E,
    0x3E, 0x6B, 0x4F, 0x6B, 0x3E,
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    0x00, 0x00, 0x00, 0x00, 0x00
};

void Delay()
{
    int i;
    for (i = 0; i < 3000; i++)
    {
        __asm NOP __endasm;
        __asm NOP __endasm;
        __asm NOP __endasm;
        __asm NOP __endasm;
    }
}

void delay1(uint16_t time)
{
    while (time--)
    {
        Delay();
    }
}

// Define I2C Address
#define OLED_ADDR 0x3C

// Define Commands
#define OLED_CMD_DISPLAY_OFF 0xAE
#define OLED_CMD_DISPLAY_ON 0xAF
#define OLED_CMD_SET_COL_ADDRESS 0x21
#define OLED_CMD_SET_PAGE_ADDRESS 0x22
#define OLED_CMD_SET_START_LINE 0x40
#define OLED_CMD_SET_CONTRAST 0x81

__xdata uint8_t display_buffer[512];

static void oled_cmd(uint8_t cmd) {
    i2c_write(OLED_ADDR, 0x00, &cmd, 1);
}

static void oled_data(uint8_t data) {
    i2c_write(OLED_ADDR, 0x40, &data, 1);
}

void oled_display()
{
    uint16_t posi = 0;
    uint8_t page;
    for (page = 0; page < 4; page++)
    {
        oled_cmd(0xB0 + page);
        oled_cmd(0x00);
        oled_cmd(0x10);
        i2c_write(OLED_ADDR, 0x40, display_buffer + posi, 128);
        posi += 128;
    }
}

void oled_clear(uint8_t state)
{
    memset(display_buffer, state, 512);
    oled_display();
}

__xdata uint8_t cursor_x, cursor_y, textsize;
__xdata uint16_t textcolor, textbgcolor;

void drawPixel(int16_t x, int16_t y, uint16_t color)
{
    switch (color)
    {
    case 1:
        display_buffer[x + (y / 8) * 128] |= (1 << (y & 7));
        break;
    case 0:
        display_buffer[x + (y / 8) * 128] &= ~(1 << (y & 7));
        break;
    }
}

void drawFastVLine(int16_t x, int16_t y, int16_t h, uint16_t color)
{
    while (h--)
    {
        drawPixel(x, y + h - 1, color);
    }
}

void fillRect(int16_t x, int16_t y, int16_t w, int16_t h, uint16_t color)
{
    for (y = h; y > 0; y--)
    {
        for (x = w; x > 0; x--)
        {
            drawPixel(x + w - 1, y + h - 1, color);
        }
    }
}

void drawChar(int16_t x, int16_t y, unsigned char c, uint16_t color, uint16_t bg, uint8_t size)
{
    for (int8_t i = 0; i < 5; i++)
    {
        uint8_t line = font[c * 5 + i];
        for (int8_t j = 0; j < 8; j++, line >>= 1)
        {
            if (line & 1)
            {
                if (size == 1)
                    drawPixel(x + i, y + j, color);
                else
                    fillRect(x + i * size, y + j * size, size, size, color);
            }
            else if (bg != color)
            {
                if (size == 1)
                    drawPixel(x + i, y + j, bg);
                else
                    fillRect(x + i * size, y + j * size, size, size, bg);
            }
        }
    }
    if (bg != color)
    {
        if (size == 1)
            drawFastVLine(x + 5, y, 8, bg);
        else
            fillRect(x + 5 * size, y, size, 8 * size, bg);
    }
}

void write(uint8_t c)
{
    if (c == '\n')
    {
        cursor_x = 0;
        cursor_y += textsize * 8;
    }
    else if (c != '\r')
    {
        /*if(((cursor_x + textsize * 6) > 240)) { // Off right?
            cursor_x  = 0;                 // Reset x to zero,
            cursor_y += textsize * 8;      // advance y one line
            }   */
        drawChar(cursor_x, cursor_y, c, textcolor, textbgcolor, textsize);
        cursor_x += textsize * 6;
    }
}

void print(char text[])
{
    uint16_t poi = 0;
    while (text[poi] != 0)
    {
        write(text[poi++]);
    }
}

__xdata char str[256];
uint16_t ddd = 0;
void main(void) {
    P_SW2 = 0x80; // Enable access to XFR

    wdt_init();
    timer_init();
    adc_init();
    eeprom_init();
    tip_init();
    i2c_init();
    oled_init();

    textsize = 1;
    textcolor = 1, textbgcolor = 0;
    while (1) {
        wdt_reset();
        if (P32 == 0)
            ddd++;
        else if (P30 == 0)
            ddd--;
        else if (P31 == 0)
            ddd = 0;
        cursor_x = 0;
        cursor_y = 0;
        memset(display_buffer, 0x00, 512);
        uint32_t vin = adc_read(0);
        uint16_t vin_volts = (vin * (MEASURED_5V_MV / 10)) / 4095;
        sprintf(str, "VIN: %u.%uv (%lu)\n", vin_volts / 10, vin_volts % 10, vin);
        print(str);
        oled_display();
        // P34 = 1;
        // delay1(1);
        // P34 = 0;
        // delay1(1);
    }
}